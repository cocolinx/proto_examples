## boards/cocolinx/proto/board.yml
```yaml
board:
  name: cocolinx_proto
  full_name: nRF9151 Proto
  vendor: cocolinx
  socs:
  - name: nrf9151
    variants:
    - name: 'ns'
```

## flash/boards/cocolinx/proto/Kconfig.cocolinx_proto
```kconfig
# Copyright (c) 2025 cocolinx
# Copyright (c) 2018-2020 Nordic Semiconductor ASA
# SPDX-License-Identifier: Apache-2.0

config BOARD_COCOLINX_PROTO
	select SOC_NRF9151_LACA
```
